## Platform/divo/sc9832e/dw99/UniXNU/configs/dw99_defconfig
```kconfig
CONFIG_XNU_SOURCE_CORECRYPTO14=n
CONFIG_XNU_SOURCE_PTHREAD=y
CONFIG_XNU_ARM_DT_PLATFORM=y
CONFIG_XNU_ARMCPU=y
CONFIG_XNU_NATIVE_ARCH_TIMER=y
CONFIG_XNU_NATIVE_PAN=n
CONFIG_XNU_CRYPTO_BOOTSTRAP="prelinked"
CONFIG_XNU_ARMVIRT_PLATFORM=n
CONFIG_XNU_NATIVE_UFS=n
CONFIG_XNU_NATIVE_ADRENO=n
CONFIG_XNU_NATIVE_MOBILE_DISPLAY=n
CONFIG_XNU_NATIVE_LEGACY_DISPLAY=n
CONFIG_XNU_SHENG_PMGR=n
CONFIG_XNU_BOOT_PROGRESS=n
```
